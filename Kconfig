## Kconfig
```kconfig
#
# For a description of the syntax of this configuration file,
# see Documentation/kbuild/kconfig-language.txt.
#
mainmenu "Linux/$ARCH $KERNELVERSION Kernel Configuration"

config SRCARCH
	string
	option env="SRCARCH"

config VENDOR_XIAOMI
	bool "Xiaomi support"
	help
	  This feature enables Xiaomi specific hacks

source "arch/$SRCARCH/Kconfig"
```
